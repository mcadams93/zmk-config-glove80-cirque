## config/west.yml
```yaml
manifest:
  remotes:
    - name: zmkfirmware
      url-base: https://github.com/zmkfirmware
    - name: halfdane
      url-base: https://github.com/halfdane/
  projects:
    - name: zmk
      remote: zmkfirmware
      revision: main
      import: app/west.yml
    - name: zmk-input-gestures
      remote: halfdane
      revision: main
    - name: zmk-input-processors
      remote: halfdane
      revision: main
  self:
    path: config
```
